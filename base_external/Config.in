## base_external/Config.in
```kconfig
source "$BR2_EXTERNAL_project_base_PATH/package/aesd-assignments/Config.in"
source "$BR2_EXTERNAL_project_base_PATH/package/dlib/Config.in"
source "$BR2_EXTERNAL_project_base_PATH/package/distro/Config.in"
source "$BR2_EXTERNAL_project_base_PATH/package/wheel/Config.in"
source "$BR2_EXTERNAL_project_base_PATH/package/pyparsing/Config.in"
source "$BR2_EXTERNAL_project_base_PATH/package/eye-game/Config.in"
```

## base_external/configs/aesd_rpi_defconfig
```kconfig
BR2_arm=y
BR2_cortex_a53=y
BR2_ARM_FPU_NEON_VFPV4=y
BR2_TOOLCHAIN_BUILDROOT_GLIBC=y
BR2_KERNEL_HEADERS_4_19=y
BR2_BINUTILS_VERSION_2_33_X=y
BR2_TOOLCHAIN_BUILDROOT_CXX=y
BR2_GCC_ENABLE_LTO=y
BR2_GCC_ENABLE_OPENMP=y
BR2_GCC_ENABLE_GRAPHITE=y
BR2_PACKAGE_HOST_GDB=y
BR2_PACKAGE_HOST_GDB_PYTHON=y
BR2_ROOTFS_DEVICE_CREATION_DYNAMIC_MDEV=y
BR2_TARGET_GENERIC_ROOT_PASSWD="root"
BR2_SYSTEM_DHCP="eth0"
BR2_ROOTFS_OVERLAY="../base_external/rootfs_overlay"
BR2_ROOTFS_POST_BUILD_SCRIPT="board/raspberrypi3/post-build.sh"
BR2_ROOTFS_POST_IMAGE_SCRIPT="../base_external/rootfs_overlay/etc/post-image.sh"
BR2_ROOTFS_POST_SCRIPT_ARGS="--add-I2C"
BR2_LINUX_KERNEL=y
BR2_LINUX_KERNEL_CUSTOM_TARBALL=y
BR2_LINUX_KERNEL_CUSTOM_TARBALL_LOCATION="$(call github,raspberrypi,linux,64d0a9870ac14d5eb5253f67d984ae348eec1393)/linux-64d0a9870ac14d5eb5253f67d984ae348eec1393.tar.gz"
BR2_LINUX_KERNEL_DEFCONFIG="bcm2709"
BR2_LINUX_KERNEL_DTS_SUPPORT=y
BR2_LINUX_KERNEL_INTREE_DTS_NAME="bcm2710-rpi-3-b bcm2710-rpi-3-b-plus bcm2710-rpi-cm3"
BR2_LINUX_KERNEL_NEEDS_HOST_OPENSSL=y
BR2_PACKAGE_BUSYBOX_SHOW_OTHERS=y
BR2_PACKAGE_FFMPEG_FFPLAY=y
BR2_PACKAGE_GZIP=y
BR2_PACKAGE_STRACE=y
BR2_PACKAGE_BINUTILS=y
BR2_PACKAGE_BINUTILS_TARGET=y
BR2_PACKAGE_CMAKE_CTEST=y
BR2_PACKAGE_GIT=y
BR2_PACKAGE_GREP=y
BR2_PACKAGE_MAKE=y
BR2_PACKAGE_CURLFTPFS=y
BR2_PACKAGE_DEJAVU=y
BR2_PACKAGE_FSWEBCAM=y
BR2_PACKAGE_FBV=y
BR2_PACKAGE_MESA3D=y
BR2_PACKAGE_MESA3D_GALLIUM_DRIVER_SWRAST=y
BR2_PACKAGE_MESA3D_OPENGL_EGL=y
BR2_PACKAGE_MESA3D_OPENGL_ES=y
# BR2_PACKAGE_SDL_FBCON is not set
BR2_PACKAGE_SDL_X11=y
BR2_PACKAGE_SDL_IMAGE_GIF=y
BR2_PACKAGE_SDL_IMAGE_TIFF=y
BR2_PACKAGE_SDL2_X11=y
BR2_PACKAGE_SDL2_IMAGE=y
BR2_PACKAGE_TK=y
BR2_PACKAGE_XORG7=y
BR2_PACKAGE_XAPP_XCLOCK=y
BR2_PACKAGE_XAPP_XEDIT=y
BR2_PACKAGE_XAPP_XEYES=y
BR2_PACKAGE_XAPP_XKBCOMP=y
BR2_PACKAGE_RPI_BT_FIRMWARE=y
BR2_PACKAGE_RPI_FIRMWARE=y
BR2_PACKAGE_RPI_FIRMWARE_X=y
BR2_PACKAGE_RPI_WIFI_FIRMWARE=y
BR2_PACKAGE_GPSD=y
BR2_PACKAGE_GPSD_CLIENT_DEBUG=y
BR2_PACKAGE_GPSD_GPSCLOCK=y
BR2_PACKAGE_MDEVD=y
BR2_PACKAGE_RASPI_GPIO=y
BR2_PACKAGE_RNG_TOOLS=y
BR2_PACKAGE_RTC_TOOLS=y
BR2_PACKAGE_SYSSTAT=y
BR2_PACKAGE_PYTHON3=y
BR2_PACKAGE_PYTHON3_PY_PYC=y
BR2_PACKAGE_PYTHON3_BZIP2=y
BR2_PACKAGE_PYTHON3_CURSES=y
BR2_PACKAGE_PYTHON3_XZ=y
BR2_PACKAGE_PYTHON_CAN=y
BR2_PACKAGE_PYTHON_CERTIFI=y
BR2_PACKAGE_PYTHON_CHANNELS=y
BR2_PACKAGE_PYTHON_CHARDET=y
BR2_PACKAGE_PYTHON_CLICK=y
BR2_PACKAGE_PYTHON_DAEMON=y
BR2_PACKAGE_PYTHON_DAEMONIZE=y
BR2_PACKAGE_PYTHON_HIREDIS=y
BR2_PACKAGE_PYTHON_LIBCONFIG=y
BR2_PACKAGE_PYTHON_LIBUSB1=y
BR2_PACKAGE_PYTHON_MSGPACK=y
BR2_PACKAGE_PYTHON_NETADDR=y
BR2_PACKAGE_PYTHON_PILLOW=y
BR2_PACKAGE_PYTHON_PIP=y
BR2_PACKAGE_PYTHON_POSIX_IPC=y
BR2_PACKAGE_PYTHON_PY=y
BR2_PACKAGE_PYTHON_PYGAME=y
BR2_PACKAGE_PYTHON_PYGAME_IMAGE=y
BR2_PACKAGE_PYTHON_PYGAME_EXAMPLES=y
BR2_PACKAGE_PYTHON_PYGAME_FONT=y
BR2_PACKAGE_PYTHON_PYGAME_MIXER=y
BR2_PACKAGE_PYTHON_PYGAME_MIXER_MUSIC=y
BR2_PACKAGE_PYTHON_PYUSB=y
BR2_PACKAGE_PYTHON_RPI_GPIO=y
BR2_PACKAGE_PYTHON_URLLIB3=y
BR2_PACKAGE_LIBSSH=y
BR2_PACKAGE_LIBSSH_SERVER=y
BR2_PACKAGE_LIBGTK3=y
BR2_PACKAGE_OPENCV3=y
BR2_PACKAGE_OPENCV3_LIB_HIGHGUI=y
BR2_PACKAGE_OPENCV3_WITH_GTK3=y
BR2_PACKAGE_OPENCV3_LIB_OBJDETECT=y
BR2_PACKAGE_OPENCV3_LIB_PYTHON=y
BR2_PACKAGE_OPENCV3_LIB_VIDEOSTAB=y
BR2_PACKAGE_OPENCV3_WITH_FFMPEG=y
BR2_PACKAGE_OPENCV3_WITH_JASPER=y
BR2_PACKAGE_OPENCV3_WITH_JPEG=y
BR2_PACKAGE_OPENCV3_WITH_PNG=y
BR2_PACKAGE_OPENCV3_WITH_TIFF=y
BR2_PACKAGE_OPENCV3_WITH_V4L=y
BR2_PACKAGE_LIBGPHOTO2=y
BR2_PACKAGE_LIBGPIOD=y
BR2_PACKAGE_LIBGPIOD_TOOLS=y
BR2_PACKAGE_LIBPCIACCESS=y
BR2_PACKAGE_LIBUSB_EXAMPLES=y
BR2_PACKAGE_LIBUSB_COMPAT=y
BR2_PACKAGE_LIBV4L=y
BR2_PACKAGE_LIBV4L_UTILS=y
BR2_PACKAGE_WIRINGPI=y
BR2_PACKAGE_NCURSES_WCHAR=y
BR2_PACKAGE_NCURSES_TARGET_PROGS=y
BR2_PACKAGE_AUTOSSH=y
BR2_PACKAGE_CONNMAN=y
BR2_PACKAGE_CONNMAN_WIFI=y
BR2_PACKAGE_CONNMAN_BLUETOOTH=y
BR2_PACKAGE_DHCPCD=y
BR2_PACKAGE_DROPBEAR=y
BR2_PACKAGE_HOSTAPD=y
BR2_PACKAGE_HOSTAPD_DRIVER_WIRED=y
BR2_PACKAGE_IW=y
BR2_PACKAGE_OPENSSH=y
BR2_PACKAGE_PUTTY=y
BR2_PACKAGE_SSHPASS=y
BR2_PACKAGE_WIRELESS_TOOLS=y
BR2_PACKAGE_WIRELESS_TOOLS_LIB=y
BR2_PACKAGE_WPA_SUPPLICANT_AP_SUPPORT=y
BR2_PACKAGE_WPA_SUPPLICANT_WIFI_DISPLAY=y
BR2_PACKAGE_WPA_SUPPLICANT_CLI=y
BR2_PACKAGE_WPA_SUPPLICANT_WPA_CLIENT_SO=y
BR2_PACKAGE_WPA_SUPPLICANT_PASSPHRASE=y
BR2_PACKAGE_SUDO=y
BR2_PACKAGE_KMOD=y
BR2_PACKAGE_UTIL_LINUX_LIBBLKID=y
BR2_PACKAGE_UTIL_LINUX_RFKILL=y
BR2_TARGET_ROOTFS_EXT2=y
BR2_TARGET_ROOTFS_EXT2_4=y
BR2_TARGET_ROOTFS_EXT2_SIZE="1024M"
BR2_PACKAGE_HOST_CMAKE=y
BR2_PACKAGE_HOST_DOSFSTOOLS=y
BR2_PACKAGE_HOST_GENIMAGE=y
BR2_PACKAGE_HOST_MTOOLS=y
BR2_PACKAGE_AESD_ASSIGNMENTS=y
BR2_PACKAGE_DLIB=y
BR2_PACKAGE_DLIB_GUI_SUPPORT=y
BR2_PACKAGE_DLIB_PYTHON_MODULE=y
BR2_PACKAGE_FACE_RECOGNITION=y
BR2_PACKAGE_FACE_RECOGNITION_MODELS=y
BR2_PACKAGE_PACKAGING=y
BR2_PACKAGE_DISTRO=y
BR2_PACKAGE_WHEEL=y
BR2_PACKAGE_PYPARSING=y
BR2_PACKAGE_SCIKIT_BUILD=y
```

## base_external/package/face_recognition/Config.in
```kconfig
config BR2_PACKAGE_FACE_RECOGNITION
	bool "face_recognition"
	help
	  Includes the face-recognition package for python.
```

## base_external/package/face_recognition_models/Config.in
```kconfig
config BR2_PACKAGE_FACE_RECOGNITION_MODELS
	bool "face_recognition_models"
	help
	  Includes the face-recognition_models package for python.
```

## base_external/package/opencv-python/Config.in
```kconfig
config BR2_PACKAGE_OPENCV_PYTHON
	bool "opencv-python"
	help
	  Includes the opencv-python package for python.
```

## base_external/package/packaging/Config.in
```kconfig
config BR2_PACKAGE_PACKAGING
	bool "packaging"
	help
	  Includes the packaging package for python.
```

## base_external/package/python-dlib/Config.in
```kconfig
config BR2_PACKAGE_PYTHON_DLIB
    bool "python-dlib"
    help
      library for python dlib
```

## base_external/package/python-tk/Config.in
```kconfig
config BR2_PACKAGE_PYTHON_TK
	bool "python-tk"
	help
	  TensorKit is a deep learning helper between Python and C++.

	  https://github.com/atranitell/TensorKit
```

## base_external/package/scikit-build/Config.in
```kconfig
config BR2_PACKAGE_SCIKIT_BUILD
	bool "scikit-build"
	help
	  Includes the scikit-build package for python.
```
